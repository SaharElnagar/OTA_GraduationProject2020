/*
 * GW_main.c
 *
 *  Created on: March 16, 2020
 *      Author: Sahar Elnagar
 */


/*****************************************************************************************/
/*                                   Include Component headres                           */
/*****************************************************************************************/
#include "Packet.h"
#include "stdint.h"
#include "bl_CAN.h"
#include "tm4c123gh6pm.h"
#include "sysctl.h"

uint8_t Packet_Buffer[(PACKETS_NUM*PACKET_SIZE)+EXTRA_BYTES]=
	{
	0x10,0x04,0x00,0x20,0x6D,0x12,0x00,0x00,0x71,0x12,0x00,0x00,0x73,0x12,0x00,0x00,
	0x75,0x12,0x00,0x00,0x77,0x12,0x00,0x00,0x79,0x12,0x00,0x00,0x00,0x00,0x00,0x00,
	0x00,0x00,0x00,0x00,0x00,0x00,0x00,0x00,0x00,0x00,0x00,0x00,0x7B,0x12,0x00,0x00,
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	0x00,0x00,0x00,0x00
	};
/*****************************************************************************************/
/*                                   Local Function Definition                           */
/*****************************************************************************************/
void PortF_Init(void);

/*****************************************************************************************/
/*                                   Local types Definition                              */
/*****************************************************************************************/  	
typedef struct
{
	uint16_t PacketsNum ;
  uint16_t ExtraBytes ;
}str_FrameInfo ;

/*****************************************************************************************/
/*                                   main function                                       */
/*****************************************************************************************/ 
int main(void)
{
	volatile uint8_t SW1=0,SW2=0;
	uint8_t Frame[8] ;
	uint16_t Cmd_Status ;
	str_FrameInfo FrameInfo =
  {
	 PACKETS_NUM,
	 EXTRA_BYTES
	} ;
	
	PLL_Init();
	Can_Init();
	PortF_Init();
	while(1)
	{
		/*Gateway state machine to update one ECU*/
		 switch(Cmd_Status) 
		 {
		 case REQUEST_TO_UPDATE:
					 /* 
						* Send to the ECU request to update
						*/
		        CanTransmitBlocking_Function(2,(uint8_t*)&Cmd_Status);
						Cmd_Status = RECEIVE_FREAME_INFO_REQUEST ;
		     
		 break;
		 case RECEIVE_FREAME_INFO_REQUEST:
					 /* 
						* Wait till the ECU request the frame info
						* Then go to SEND_FRAME_INFO
						*/
						CanReceiveBlocking_Function(2,(uint8_t*)&Cmd_Status);
		       
		 break;
		 case SEND_FRAME_INFO:
				 /*  
					* Send the frame info
					* Then go to READY_TO_RECEIVE_UPDATE
					*/
		      (*(uint16_t*)Frame)      = PACKETS_NUM ;
		      (*(uint16_t*)(Frame+2))  = EXTRA_BYTES ;
		      (*(uint32_t*)(Frame+4))  = CHECKSUM    ;
					CanTransmitBlocking_Function(8,Frame)  ;
          Cmd_Status = READY_TO_RECEIVE_UPDATE;		 
		 break;
		 case READY_TO_RECEIVE_UPDATE :
				 /*
					* Wait for the ECU to be ready to receive the update 
					*/
		      Cmd_Status = 0;
					CanReceiveBlocking_Function(2,(uint8_t*)&Cmd_Status);	         			 
		 break;
		 case SEND_PACKET:
				 /*
					* Send a packet to the ECU
					*/					
					if(FrameInfo.PacketsNum>0)
					{
						CanTransmitBlocking_Function(PACKET_SIZE,Packet_Buffer);
						FrameInfo.PacketsNum-=1 ;
						Cmd_Status = SEND_NEW_PACKET ;
					}
					else
					{
						CanTransmitBlocking_Function(EXTRA_BYTES,Packet_Buffer);
						FrameInfo.ExtraBytes = 0 ;
						Cmd_Status = END_OF_FRAME ;
					}						
		 break;
		 case SEND_NEW_PACKET:
				 /*
					* Request to send new packet 
					*/
					CanTransmitBlocking_Function(2,(uint8_t*)&Cmd_Status);
					Cmd_Status = SEND_PACKET ;			 
		 break;
		 case END_OF_FRAME:
				 /*Wait For ECU to confirm update succeeded*/
	        CanReceiveBlocking_Function(2,(uint8_t*)&Cmd_Status);					
		 break;
		 case UPDATE_SUCCESS:
			    GPIO_PORTF_DATA_R &= ~0xF;
          GPIO_PORTF_DATA_R |=  0x8 ;
		 break;
		 default:
				 /*Wait for start indication*/						 
					SW1 = GPIO_PORTF_DATA_R&0x10;     /* read PF4 into SW1*/
					if(!SW1 )
				 {
					  GPIO_PORTF_DATA_R &= ~0xF;
            GPIO_PORTF_DATA_R |=  0x4 ;
						Cmd_Status = REQUEST_TO_UPDATE ;
				 }
				 else
				 {
				 /*MISRA Rule*/
				 }
		 break;
	 }
	}
}

void PortF_Init(void){
  SYSCTL_RCGC2_R |= SYSCTL_RCGCGPIO_R5;                    // 1) F clock
  while(!(SYSCTL_PRGPIO_R &SYSCTL_PRGPIO_R5)){};           // delay
  GPIO_PORTF_LOCK_R = 0x4C4F434B;   // 2) unlock PortF PF0
  GPIO_PORTF_CR_R = 0x1F;           // allow changes to PF4-0
  GPIO_PORTF_AMSEL_R = 0x00;        // 3) disable analog function
  GPIO_PORTF_PCTL_R = 0x00000000;   // 4) GPIO clear bit PCTL
  GPIO_PORTF_DIR_R = 0x0E;          // 5) PF4,PF0 input, PF3,PF2,PF1 output
  GPIO_PORTF_AFSEL_R = 0x00;        // 6) no alternate function
  GPIO_PORTF_PUR_R = 0x11;          // enable pullup resistors on PF4,PF0
  GPIO_PORTF_DEN_R = 0x1F;          // 7) enable digital pins PF4-PF0
}

